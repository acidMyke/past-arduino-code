#include <avr/pgmspace.h>

int x[] = {13, 12, 11};
int y[] = {9, 8, 7, 6, 5, 4, 3, 2};
int xEn = 10;

PROGMEM const unsigned char CH[] = {  // Data store as no of column (max 5), no of row, column data 1, column data 2, column data 3, column data 4, column data 5
  3, 8, B00000000, B00000000, B00000000, B00000000, B00000000, // space
  1, 8, B01011111, B00000000, B00000000, B00000000, B00000000, // !
  3, 8, B00000011, B00000000, B00000011, B00000000, B00000000, // "
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  4, 8, B00001000, B00000100, B00001000, B00000100, B00000000, // ~
};

byte data[8];

void shiftByte(byte b, uint64_t time = 5000);

void setup() {
  Serial.begin(115200);
  for(int i = 0; i < 8; i++) data[i] = 0xFF;
  int prevMillis = millis() + 5000;
  while (prevMillis > millis()) matrixUpdate();
  for(int i = 0; i < 8; i++) data[i] = 0x00;
  matrixUpdate();
  shiftString("Begin!!!");
}

void loop() {
  matrixUpdate();
}

void serialEvent() {
  for (int i = 0; i < 8; i++) shiftByte(0xFF, 10); // wipe the previous data
  for (int i = 0; i < 8; i++) shiftByte(0x00, 10); // wipe the previous data
  while (Serial.available()) {
    byte value = Serial.read();
    if (value >= 0x20) shiftLetter(value);
    else Serial.write(0x2E);
  }
  Serial.println();
}

void shiftString(String str) {
  for (int i = 0; i < 8; i++) shiftByte(0xFF, 10); // wipe the previous data
  for (int i = 0; i < 8; i++) shiftByte(0x00, 10); // wipe the previous data
  for (int q = 0; q < str.length(); q++) shiftLetter(str.charAt(q));
  Serial.println();
}

void shiftLetter(char ch) {
  Serial.print("\nCharater: " + String(ch));
  ch -= 32;
  int size = pgm_read_byte(CH + 7 * ch);
  Serial.print("\nBuffer Size: " + String(size, DEC));
  byte buffer[size + 1];
  for (int i = 0; i < size; i++)
    buffer[i] = pgm_read_byte(CH + 7 * ch + 2 + i);
  buffer[size] = 0x00; // very small spacing
  Serial.print("\nBuffer:");
  for (int i = 0; i < size; i++) Serial.print("\n\t" + Byte(buffer[i]));
  for (int z = 0; z <= size; z++) shiftByte(buffer[z]);
}

void shiftByte(byte b, uint64_t time) {
  for (int i = 0; i < 7; i++) data[i] = data[i + 1]; // shift the data to the right
  data[7] = b;
  printData("\nShift Bytes: ");
  int prevMillis = millis() + time;
  while (prevMillis > millis()) matrixUpdate();
}

void matrixUpdate() {
  //printData("\nPrint Bytes: ");
  for (int a = 0; a < 8; a++) {
    digitalWrite(xEn, LOW);
    for (int i = 0; i < 3; i++) digitalWrite(x[i], bitRead(a, i));
    for (int b = 0; b < 8; b++) digitalWrite(y[b], bitRead(data[a], b)); //random(0, 2) //bitRead(data[a], 7 - b)
    digitalWrite(xEn, HIGH);
    delayMicroseconds(500);
  }
}

void printData(String str) {
  Serial.print(str);
  for (int i = 0; i < 8; i++) Serial.print("\n\t" + Byte(data[i]));
}

String Byte(byte b){
  String str = String(b, BIN);
  switch (str.length()){
    case 1: str = "B0000000" + str; break;
    case 2: str = "B000000" + str; break;
    case 3: str = "B00000" + str; break;
    case 4: str = "B0000" + str; break;
    case 5: str = "B000" + str; break;
    case 6: str = "B00" + str; break;
    case 7: str = "B0" + str; break;
    case 8: str = "B" + str; break;
  }
  return str;
}

